## esp32/sdkconfig.defaults
```kconfig
# 5map ESP32-S2 CSI Scanner SDK config
# WiFi CSI only (ESP32-S2 has no Bluetooth)

# WiFi
CONFIG_ESP_WIFI_ENABLE_CSI=y
CONFIG_ESP_WIFI_STA_DISCONNECTED_PM_ENABLE=n
CONFIG_ESP_WIFI_SOFTAP_SUPPORT=n

# CSI transmitter AP (mini router config)
CONFIG_CSI_AP_SSID="5map-csi"
CONFIG_CSI_AP_PASS="5mapcsi2024"
CONFIG_CSI_AP_CHANNEL=6

# No Bluetooth on ESP32-S2
CONFIG_BT_ENABLED=n

# Serial output over USB CDC
CONFIG_ESP_CONSOLE_UART_BAUDRATE=921600
CONFIG_ESP_CONSOLE_USB_CDC=y

# Stack sizes (CSI + base64 encoding needs more stack)
CONFIG_ESP_MAIN_TASK_STACK_SIZE=8192
CONFIG_ESP_SYSTEM_EVENT_TASK_STACK_SIZE=4096

# mbedTLS (needed for base64 encoding of CSI data)
CONFIG_MBEDTLS_CERTIFICATE_BUNDLE=n

# Partition table
CONFIG_PARTITION_TABLE_SINGLE_APP=y

# Log level (reduce noise in serial output)
CONFIG_LOG_DEFAULT_LEVEL_WARN=y
CONFIG_LOG_MAXIMUM_LEVEL_INFO=y
```
